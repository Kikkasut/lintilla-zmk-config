## boards/shields/lintilla/Kconfig.defconfig
```kconfig
# Copyright (c) 2020 The ZMK Contributors
# SPDX-License-Identifier: MIT

if SHIELD_LINTILLA_DONGLE

config ZMK_KEYBOARD_NAME
	default "lintilla Dongle"
	
config ZMK_SPLIT_BLE_ROLE_CENTRAL
	default y
	
config ZMK_USB
	default y

endif

if SHIELD_LINTILLA_LEFT || SHIELD_LINTILLA_RIGHT || SHIELD_LINTILLA_DONGLE 

config ZMK_SPLIT
	default y

config ZMK_BLE
	default y
	
endif
```

## boards/shields/lintilla/Kconfig.shield
```kconfig
# Copyright (c) 2020 The ZMK Contributors
# SPDX-License-Identifier: MIT

config SHIELD_LINTILLA_LEFT
	def_bool $(shields_list_contains,lintilla_left)

config SHIELD_LINTILLA_RIGHT
	def_bool $(shields_list_contains,lintilla_right)

config SHIELD_LINTILLA_DONGLE
	def_bool $(shields_list_contains,lintilla_dongle)
```

## config/west.yml
```yaml
manifest:
  remotes:
    - name: zmkfirmware
      url-base: https://github.com/zmkfirmware
    - name: caksoylar # <-- and this for the LED
      url-base: https://github.com/caksoylar
  projects:
    - name: zmk
      remote: zmkfirmware
      revision: main
      import: app/west.yml
    - name: zmk-rgbled-widget # <-- and this for the LED
      remote: caksoylar
      revision: main
  self:
    path: config
```
